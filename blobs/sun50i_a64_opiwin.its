## blobs/sun50i_a64_opiwin.its
```
/dts-v1/;

/ {
	description = "Configuration to load ATF before U-Boot";
	#address-cells = <1>;

	images {
		uboot@1 {
			description = "U-Boot (64-bit)";
			data = /incbin/("u-boot.bin");
			type = "standalone";
			arch = "arm64";
			compression = "none";
			load = <0x4a000000>;
		};
		atf@1 {
			description = "ARM Trusted Firmware";
			data = /incbin/("bl31.bin");
			type = "firmware";
			arch = "arm64";
			compression = "none";
			load = <0x44000>;
			entry = <0x44000>;
		};
                fdt@1 {
                        description = "OrangePiWin DT";
                        data = /incbin/("u-boot/arch/arm/dts/sun50i-a64-orangepiwin.dtb");
                        type = "flat_dt";
                        compression = "none";
                        load = <0x4fa00000>;
                };
	};
	configurations {
		default = "config@1";

		config@1 {
                        description = "Pine64";
                        loadables = "atf@1", "uboot@1";
                        fdt = "fdt@1";
                };
	};
};
```
